## conf/layer.conf
```bitbake
BBPATH .= ":${LAYERDIR}"

BBFILES += "${LAYERDIR}/recipes*/*/*.bb \
            ${LAYERDIR}/recipes*/*/*.bbappend"

BBFILE_COLLECTIONS += "customgw"
BBFILE_PATTERN_customgw := "^${LAYERDIR}/"
BBFILE_PRIORITY_customgw = "9"
```
